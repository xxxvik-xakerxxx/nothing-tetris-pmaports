## patches/camera-camisp/cold-integration/board/Kconfig
```kconfig
# SPDX-License-Identifier: GPL-2.0-only
config VIDEO_MT6878_COLD_BOARD
	bool "Nothing Tetris producer-driven CAMSV0 root (unvalidated)"
	depends on VIDEO_MT6878_COLD_CAPTURE=y && OF && PM
	default n
	help
	  Own static board suppliers and call the existing capture constructor
	  after actual driver binding and producer metadata publication.
	  No fixed image/PDAF layout or firmware ownership handoff is supplied.
```

## patches/gpu/flat-handoff-draft/Kconfig.flat-retention
```kconfig
config TETRIS_GPUEB_FLAT_RETENTION_DIAGNOSTIC
	bool "Retain authenticated GPUEB primary for private analysis"
	default n
	depends on TETRIS_SCP_PREPARE_DIAGNOSTIC && TETRIS_SCP_SECURITY && LMB && OF_LIBFDT
	depends on !TETRIS_GPUEB_TRANSFORM_DIAGNOSTIC
	help
	  One strict slot-A transform in the existing verified B4.1 crypto window.
	  Keep only authenticated bytes in a dedicated no-map RAM reservation,
	  publish to final Linux DT for private root-only analysis. No upload,
	  reset release, clocks, rails, EMI programming or GPUEB execution.
```

## patches/gpu/mmio-scope/Kconfig
```kconfig
# Not sourced by shipping Kconfig.
config MTK_MT6878_GPUEB_IO_SCOPE
	bool "MT6878 GPUEB bounded parent MMIO scope (candidate)"
	depends on MTK_MT6878_GPUEB_ADOPTION
	default n
	help
	  Bounded 32-bit transport engine and resource lifetime. Hardware power
	  ownership and IRQ activation are unproven and remain inaccessible.
```

## patches/gpu/reset-provider-draft/Kconfig
```kconfig
config MTK_MT6878_GPUEB_RESET_PROVIDER
	tristate "MT6878 GPUEB parent-owned reset checkpoint (draft)"
	depends on ARM64 && OF && PM && RESET_CONTROLLER
	default n
	help
	  Register an assertion-only reset provider from a fixed, already powered
	  unified GPUEB parent. Requires the reviewed SRAM/reset helper objects
	  in the same integration. No automatic probe, firmware upload or start.
	  Stop containment retains all claims until reboot; not physical OFF.
```

## patches/gpu/sram-adoption/Kconfig
```kconfig
# Candidate only; not sourced by packaged Kconfig.
config MTK_MT6878_GPUEB_ADOPTION
	bool "MT6878 GPUEB explicit parent SRAM adoption (candidate)"
	depends on MT6878_GPUEB_SRAM_OWNER
	default n
	help
	  Parent-issued typed resource leases, with no hardware boot or IO gate.
	  Leave disabled. Existing DT and bindings are not activated or changed.
```

## patches/modem/md-pm-integration/real-boot/Kconfig
```kconfig
# SPDX-License-Identifier: GPL-2.0-only
config MTK_MT6878_MODEM_REAL_BOOT_STAGING
	bool "MT6878 modem genuine native ON callback (staging)"
	depends on ARM64 && ARCH_MEDIATEK && HAVE_ARM_SMCCC
	depends on MTK_SCPSYS_PM_DOMAINS && OF && MFD_SYSCON
	depends on REGULATOR && REGULATOR_MT6363
	depends on MTK_MT6878_MODEM_POST_OFF_TOP_STAGING
	depends on !SCSI_UFS_MEDIATEK_DBG
	default n
	help
	  Extend the frozen native first-OFF probe with actual FLIGHT(true)
	  submission and checked TOP gating. Check the defined raw a0 using the
	  matched ATF inner contract; a1..a3 are not defined or logged. Zero does
	  not prove policy applied or modem readiness. No UFS calibration provider
	  may be present.
	  Admit the real sole CCCI consumer to the initially OFF native domain;
	  attach-time power_on executes real voltage/sync, TOP, FLIGHT(false),
	  isolation, power/ACK30 and reverse bus release with physical readbacks.
	  Intentional modem execution is allowed. This is not an inhibited
	  diagnostic restart. Firmware release, transport and lifecycle are separate.
```

## pmaports/device/testing/device-nothing-tetris/boot_image.its
```
/dts-v1/;

/ {
	description = "Nothing CMF Phone 1 native display FIT Image";
	#address-cells = <1>;

	images {
		kernel {
			description = "Kernel";
			data = /incbin/("vmlinuz");
			type = "kernel";
			arch = "arm64";
			os = "linux";
			compression = "gzip";
			load = <0x42000000>;
			entry = <0x42000000>;
		};

		fdt {
			description = "MT6878 Nothing Tetris native display DTB";
			data = /incbin/("mt6878-nothing-tetris-native.dtb");
			type = "flat_dt";
			arch = "arm64";
			compression = "none";
			load = <0x47000000>;
			entry = <0x47000000>;
		};

		initrd {
			description = "Initramfs";
			data = /incbin/("initramfs");
			type = "ramdisk";
			arch = "arm64";
			os = "linux";
			compression = "none";
			load = <0x45500000>;
			entry = <0x45500000>;
		};
	};

	configurations {
		default = "native-display";
		native-display {
			description = "Native display";
			kernel = "kernel";
			fdt = "fdt";
			ramdisk = "initrd";
		};
	};
};
```
